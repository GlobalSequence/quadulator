#ifndef LFO_H
#define LFO_H

#include <Arduino.h>
#include "math.h"
#include "noise.h"

// #define USING_ATMEGA328P

const uint16_t lfo_sine[] PROGMEM = {
	0x800,0x803,0x806,0x809,0x80c,0x80f,0x812,0x815,0x819,0x81c,0x81f,0x822,0x825,0x828,0x82b,0x82f,
0x832,0x835,0x838,0x83b,0x83e,0x841,0x845,0x848,0x84b,0x84e,0x851,0x854,0x857,0x85b,0x85e,0x861,
0x864,0x867,0x86a,0x86d,0x871,0x874,0x877,0x87a,0x87d,0x880,0x883,0x886,0x88a,0x88d,0x890,0x893,
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0x7cd,0x7d0,0x7d4,0x7d7,0x7da,0x7dd,0x7e0,0x7e3,0x7e6,0x7ea,0x7ed,0x7f0,0x7f3,0x7f6,0x7f9,0x7fc
};

#define LFO_DEFAULT_RESOLUTION_BITS 12
#define BIT_CEILING (1 << LFO_DEFAULT_RESOLUTION_BITS)
#define MAX_LFO_LEVEL (BIT_CEILING - 1)
#define HALF_MAX_LFO_LEVEL (BIT_CEILING / 2)
#define PHASE180 128
// #define MAX_LFO_LEVEL 4095
// #define BIT_CEILING MAX_LFO_LEVEL + 1
// #define HALF_MAX_LFO_LEVEL (MAX_LFO_LEVEL +  1) / 2
#define MOVING_AVERAGE_BUFFER_SIZE 32

enum WaveForm
{
    LFO_TRIANGLE,
    LFO_SAW,
    //reverse_LFO_SAW,
    LFO_SQUARE,
    LFO_SINE,
    LFO_SAMPLE_HOLD,
    NUMBER_OF_LFO_SHAPES
};

typedef struct Saw_Params {
  bool extend_phase;
  uint16_t last_sample;
} SawParams;

typedef struct Sample_Hold_Params {
  uint8_t counter_;
  uint32_t total_;
  uint16_t buffer_[MOVING_AVERAGE_BUFFER_SIZE];
} Sample_Hold_Params;

typedef struct LFO_Params {
    uint16_t phase_;
    uint16_t phase_12b_;
    uint16_t phase_increment_;
    uint16_t previous_phase_;
    uint16_t phase_shift_;
    uint8_t step_ = 0;
    uint8_t wave_ = 0;
    uint8_t level_ = 0;
    uint16_t seed_ = 0x420;
    uint8_t augment_ = 0;
    uint16_t bias_ = 0;
    uint8_t bias_multiplier_;

    bool sh_this_step_bool_;
    bool sh_last_step_bool_;
    uint16_t hold_sample_;

    bool reset_ = false;
    bool sync_ = false;
    xorShiftVariables lfoNoise;
    SawParams s;
    Sample_Hold_Params sh;
} LFO_Params;

void LFOSetup(LFO_Params* l, uint32_t seed) {

  xorShift128Init(&l->lfoNoise, seed);
}

void LFOUpdate(LFO_Params* l, uint16_t freq, uint8_t wave, uint8_t phase_shift, uint8_t augment, uint8_t bias) {

  l->phase_increment_ = freq;
  l->wave_ = wave;
  l->phase_shift_ = phase_shift;
  l->augment_ = augment;
  l->bias_ = (bias << 3);
}

uint16_t foldWave(uint16_t sample, uint8_t amt) {

  int32_t sample_32s;
  int32_t v;
  sample_32s = sample;
  sample_32s -= HALF_MAX_LFO_LEVEL;
  sample_32s = (sample_32s + (sample_32s * (amt) >> 7)); //double the wave level. fixed point fractional.
  if(sample_32s >= HALF_MAX_LFO_LEVEL) {
    v = sample_32s - HALF_MAX_LFO_LEVEL;
    sample_32s = HALF_MAX_LFO_LEVEL - v;
  } else if (sample_32s <= (-HALF_MAX_LFO_LEVEL)) {
    v = (-HALF_MAX_LFO_LEVEL) - sample_32s ;
    sample_32s = (-HALF_MAX_LFO_LEVEL) + v;
  }
  sample_32s += HALF_MAX_LFO_LEVEL;
  if(sample_32s >= MAX_LFO_LEVEL) sample_32s = MAX_LFO_LEVEL;
  return sample_32s;
}

uint16_t augmentSaw(Saw_Params* s, uint16_t sample, uint8_t amt) {

  return sample <= amt << 4 ? sample : BIT_CEILING - sample;

  // uint16_t phase_extender;
  // if(s->last_sample > sample) {
  //   s->extend_phase = s->extend_phase == true? false : true;
  // }
  // if(s->extend_phase) {
  //   phase_extender = BIT_CEILING + sample;
  // } else {
  //   phase_extender = sample;
  // }
  // s->last_sample = sample;
  // uint16_t output_sample;
  // phase_extender <= (amt << 5) ? output_sample = (int16_t)(phase_extender - 8192) * (-1) : output_sample = phase_extender/*  * 2 */;
  // return output_sample >> 1;
}

uint16_t augmentSine(uint16_t sample, uint16_t amt) {

  uint16_t phase_mod = sample + (amt << 4);
  if(phase_mod > MAX_LFO_LEVEL) {
    phase_mod -= MAX_LFO_LEVEL;
  }
  return phase_mod;
}

uint16_t augmentSampleHold(Sample_Hold_Params* sh, uint16_t sample, uint8_t amt) {

  static uint16_t current_val = 0;
  uint8_t inv_amt = ~amt;
  float step_size = inv_amt / 255.0f;
  int16_t difference = sample - current_val;
  current_val += (int16_t)(difference * step_size);
  return current_val;
}

uint16_t LFORender(LFO_Params* l) {

  l->phase_ += l->phase_increment_;
  uint16_t phase_out_ = l->phase_ + (l->phase_shift_ << 8);
  l->step_ = phase_out_ >> 8;
  l->phase_12b_ = phase_out_ >> 4;

  uint16_t sample;

  switch (l->wave_)
  {
  case LFO_TRIANGLE:
      l->step_ >= PHASE180 ? sample = (int16_t)(l->phase_12b_ - 4096) * (-2) : sample = l->phase_12b_ * 2;
      if (sample >= MAX_LFO_LEVEL) sample = MAX_LFO_LEVEL;
      sample = foldWave(sample, l->augment_);
      break;

  case LFO_SAW:
      sample = augmentSaw(&l->s, l->phase_12b_, l->augment_);
      break;

  // case reverse_LFO_SAW:
  //     sample = ~phase_12b_;
  //     break;

  case LFO_SQUARE:
      l->step_ >= (uint8_t)(l->augment_ - 128) ? sample = 0 : sample = MAX_LFO_LEVEL;
      break;

  case LFO_SINE:
      sample = /* sine_wavetable[step_] */
#ifndef USING_ATMEGA328P
      // lfo_sine[augmentSine(l->phase_12b_, l->augment_)];
      sample = foldWave(lfo_sine[l->phase_12b_], l->augment_);
#else
      pgm_read_word(&lfo_sine[augmentSine(l->phase_12b_, l->augment_)]);
#endif
      break;

  case LFO_SAMPLE_HOLD:

      // l->sh_this_step_bool_ = l->step_ >= PHASE180? true : false;
      // if (l->sh_this_step_bool_ != l->sh_last_step_bool_)
      // {
      //     sample = xorShift128(&l->lfoNoise) >> 20;
      //     l->hold_sample_ = sample;
      // }
      // else
      // {
      //     sample = l->hold_sample_;
      // }
      // l->sh_last_step_bool_ = l->sh_this_step_bool_;
      
      
      if (l->previous_phase_ > l->phase_)
      {
          sample = xorShift128(&l->lfoNoise) >> 20;
          l->hold_sample_ = sample;
      }
      else
      {
          sample = l->hold_sample_;
      }
      sample = augmentSampleHold(&l->sh, sample, l->augment_);
      break;
  }
  l->previous_phase_ = l->phase_;
  uint16_t output = sample + l->bias_;
  output = output >= MAX_LFO_LEVEL? MAX_LFO_LEVEL : output;
  return output;
}

void LFOReset(LFO_Params* l) {
    if(l->reset_) {
        l->phase_ = 0; 
        l->sh_last_step_bool_ = !l->sh_this_step_bool_;
    }
}

void LFOResetNow(LFO_Params* l) {
  l->phase_ = 0;
  l->sh_last_step_bool_ = !l->sh_this_step_bool_;
}

void LFOSetReset(LFO_Params* l, bool reset) {l->reset_ = reset;}
void LFOSetSync(LFO_Params* l, bool sync) {l->sync_ = sync;}

bool LFOGetReset(LFO_Params* l) {return l->reset_;}
bool LFOGetSync(LFO_Params* l) {return l->sync_;}

uint16_t printPhase_12b(LFO_Params* l){return l->phase_12b_;}

// class LFO
// {
// public:
//     LFO() {}
//     void Update(uint16_t freq, uint8_t wave, uint8_t phase_shift)
//     {
//         phase_increment_ = freq;
//         wave_ = wave;
//         phase_shift_ = phase_shift;
//     }

//     uint16_t Render()
//     {
//         phase_ += phase_increment_;
//         uint16_t phase_out_ = phase_ + (phase_shift_ << 8);
//         step_ = phase_out_ >> 8;
//         phase_12b_ = phase_out_ >> 4;

//         uint16_t sample;

//         switch (wave_)
//         {
//         case LFO_TRIANGLE:
//             step_ >= PHASE180 ? sample = /* ~(phase_12b_ * 2) */(int16_t)(phase_12b_ - 4096) * (-2) : sample = phase_12b_ * 2;
//             if (sample >= MAX_LFO_LEVEL) sample = MAX_LFO_LEVEL;
//             break;

//         case LFO_SAW:
//             sample = phase_12b_;
//             break;

//         // case reverse_LFO_SAW:
//         //     sample = ~phase_12b_;
//         //     break;

//         case LFO_SQUARE:
//             step_ >= PHASE180 ? sample = 0 : sample = MAX_LFO_LEVEL;
//             break;

//         case sine:
//             sample = /* sine_wavetable[step_] */lfo_sine[phase_12b_];
//             break;

//         case LFO_SAMPLE_HOLD:

//             sh_this_step_bool_ = step_ >= PHASE180? true : false;
//             if (sh_this_step_bool_ != sh_last_step_bool_)
//             {
//                 seed_ -= 17;
//                 XOR798(&seed_);
//                 sample = seed_ >> 4;
//                 hold_sample_ = sample;
//             }
//             else
//             {
//                 sample = hold_sample_;
//             }
//             sh_last_step_bool_ = sh_this_step_bool_;
//             break;
//         }
//         return sample;
//     }

//     void reset() {
//         if(reset_) {
//             phase_ = 0; 
//             sh_last_step_bool_ = !sh_this_step_bool_;
//         }
//     }

//     void setReset(bool reset) {reset_ = reset;}
//     void setSync(bool sync) {sync_ = sync;}

//     bool getReset() {return reset_;}
//     bool getSync() {return sync_;}

//     uint16_t printPhase_12b(){return phase_12b_;}

// private:
//     uint16_t phase_;
//     uint16_t phase_12b_;
//     uint16_t phase_increment_;
//     uint16_t phase_shift_;
//     uint8_t step_ = 0;
//     uint8_t wave_ = 0;
//     uint8_t level_ = 0;
//     uint16_t seed_ = 0x420;

//     bool sh_this_step_bool_;
//     bool sh_last_step_bool_;
//     //uint8_t last_step_;
//     uint16_t hold_sample_;

//     bool reset_ = false;
//     bool sync_ = false;
// };

#endif